## build-rpi/conf/bblayers.conf
```bitbake
# POKY_BBLAYERS_CONF_VERSION is increased each time build/conf/bblayers.conf
# changes incompatibly
POKY_BBLAYERS_CONF_VERSION = "2"

BBPATH = "${TOPDIR}"
BBFILES ?= ""

BBLAYERS ?= " \
  /home/tsarbomba/Documents/yocto_ws/layers/poky/meta \
  /home/tsarbomba/Documents/yocto_ws/layers/poky/meta-poky \
  /home/tsarbomba/Documents/yocto_ws/layers/poky/meta-yocto-bsp \
  /home/tsarbomba/Documents/yocto_ws/layers/meta-openembedded/meta-oe \
  /home/tsarbomba/Documents/yocto_ws/layers/meta-openembedded/meta-python \
  /home/tsarbomba/Documents/yocto_ws/layers/meta-openembedded/meta-networking \
  /home/tsarbomba/Documents/yocto_ws/layers/meta-my-layer \
  /home/tsarbomba/Documents/yocto_ws/layers/meta-raspberrypi \
  "
```

## meta-my-layer/conf/layer.conf
```bitbake
# We have a conf and classes directory, add to BBPATH
BBPATH .= ":${LAYERDIR}"

# We have recipes-* directories, add to BBFILES
BBFILES += "${LAYERDIR}/recipes-*/*/*.bb \
            ${LAYERDIR}/recipes-*/*/*.bbappend"

BBFILE_COLLECTIONS += "meta-my-layer"
BBFILE_PATTERN_meta-my-layer = "^${LAYERDIR}/"
BBFILE_PRIORITY_meta-my-layer = "6"

LAYERDEPENDS_meta-my-layer = "core"
LAYERSERIES_COMPAT_meta-my-layer = "kirkstone"
```
